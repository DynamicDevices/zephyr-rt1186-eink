## CMakeLists.txt
```
# SPDX-License-Identifier: Apache-2.0

cmake_minimum_required(VERSION 3.20.0)

find_package(Zephyr REQUIRED HINTS $ENV{ZEPHYR_BASE})
project(aesl_wamr_rt1170)

target_sources(app PRIVATE
  src/main.c
  ${CMAKE_CURRENT_SOURCE_DIR}/../../lib/wasm/wasm_package.c
)
target_include_directories(app PRIVATE ${CMAKE_CURRENT_SOURCE_DIR}/../../lib/wasm)

set(WAMR_ROOT_DIR ${ZEPHYR_WASM_MICRO_RUNTIME_MODULE_DIR})
list(APPEND CMAKE_MODULE_PATH ${WAMR_ROOT_DIR}/build-scripts)
find_package(WASISDK REQUIRED)

include(ExternalProject)
ExternalProject_Add(wasm_payload
  SOURCE_DIR        ${CMAKE_CURRENT_SOURCE_DIR}/wasm
  CONFIGURE_COMMAND ${CMAKE_COMMAND} -S ${CMAKE_CURRENT_SOURCE_DIR}/wasm -B build
                    -DCMAKE_TOOLCHAIN_FILE=${WASISDK_TOOLCHAIN}
  BUILD_COMMAND     ${CMAKE_COMMAND} --build build
  INSTALL_COMMAND   ${CMAKE_COMMAND} --install build
                    --prefix ${CMAKE_CURRENT_BINARY_DIR}/wasm
  BUILD_ALWAYS      TRUE
)

set(WASM_FILE ${CMAKE_CURRENT_BINARY_DIR}/wasm/aesl_payload.wasm)
set(DEV_PRIVATE_KEY ${CMAKE_CURRENT_BINARY_DIR}/dev-wasm-signing.pem)
set(DEV_PUBLIC_KEY ${CMAKE_CURRENT_BINARY_DIR}/dev-wasm-signing.pub)
set(WASM_PACKAGE ${CMAKE_CURRENT_BINARY_DIR}/wasm/aesl_payload.wpkg)
set(PACKAGE_TOOL ${CMAKE_CURRENT_SOURCE_DIR}/../../scripts/wasm-package.py)

add_custom_command(
  OUTPUT ${DEV_PRIVATE_KEY} ${DEV_PUBLIC_KEY}
  COMMAND ${Python3_EXECUTABLE} ${PACKAGE_TOOL} keygen
          --private ${DEV_PRIVATE_KEY} --public ${DEV_PUBLIC_KEY}
  DEPENDS ${PACKAGE_TOOL}
  COMMENT "Generating an ephemeral simulator-only WASM signing key"
  VERBATIM
)

add_custom_command(
  OUTPUT ${WASM_PACKAGE}
  COMMAND ${Python3_EXECUTABLE} ${PACKAGE_TOOL} package
          --wasm ${WASM_FILE} --output ${WASM_PACKAGE}
          --key ${DEV_PRIVATE_KEY} --version 7
  DEPENDS wasm_payload ${DEV_PRIVATE_KEY} ${PACKAGE_TOOL}
  COMMENT "Signing the simulator WASM payload"
  VERBATIM
)

set(WASM_HEADER ${CMAKE_CURRENT_BINARY_DIR}/generated/aesl_package.h)
set(PUBLIC_KEY_HEADER ${CMAKE_CURRENT_BINARY_DIR}/generated/aesl_public_key.h)
add_custom_command(
  OUTPUT ${WASM_HEADER} ${PUBLIC_KEY_HEADER}
  COMMAND ${CMAKE_COMMAND}
          -DINPUT=${WASM_PACKAGE}
          -DOUTPUT=${WASM_HEADER}
          -DSYMBOL=aesl_wasm_package
          -P ${WAMR_ROOT_DIR}/product-mini/platforms/zephyr/cmake/bin_to_header.cmake
  COMMAND ${CMAKE_COMMAND}
          -DINPUT=${DEV_PUBLIC_KEY}
          -DOUTPUT=${PUBLIC_KEY_HEADER}
          -DSYMBOL=aesl_wasm_public_key
          -P ${WAMR_ROOT_DIR}/product-mini/platforms/zephyr/cmake/bin_to_header.cmake
  DEPENDS ${WASM_PACKAGE} ${DEV_PUBLIC_KEY}
  COMMENT "Embedding the signed WASM package and simulator public key"
  VERBATIM
)
add_custom_target(embed_wasm_payload DEPENDS ${WASM_HEADER} ${PUBLIC_KEY_HEADER})
add_dependencies(app embed_wasm_payload)
target_include_directories(app PRIVATE ${CMAKE_CURRENT_BINARY_DIR}/generated)
```

## prj.conf
```kconfig
# SPDX-License-Identifier: Apache-2.0

CONFIG_PRINTK=y
CONFIG_MAIN_STACK_SIZE=8192

CONFIG_WAMR=y
CONFIG_WAMR_INTERP=y
CONFIG_WAMR_FAST_INTERP=n
CONFIG_WAMR_AOT=n
CONFIG_WAMR_LIBC_BUILTIN=n
CONFIG_WAMR_LIBC_WASI=n
CONFIG_WAMR_GLOBAL_HEAP_POOL=y
CONFIG_WAMR_GLOBAL_HEAP_SIZE=131072

CONFIG_MBEDTLS=y
CONFIG_MBEDTLS_PSA_CRYPTO_C=y
CONFIG_MBEDTLS_PSA_STATIC_KEY_SLOTS=y
CONFIG_MBEDTLS_PSA_KEY_SLOT_COUNT=2
CONFIG_PSA_WANT_KEY_TYPE_ECC_PUBLIC_KEY=y
CONFIG_PSA_WANT_ECC_SECP_R1_256=y
CONFIG_PSA_WANT_ALG_ECDSA=y
CONFIG_PSA_WANT_ALG_SHA_256=y

# Simulator-only: the RT1170 CAAM entropy peripheral is not modelled by Renode.
CONFIG_TEST_RANDOM_GENERATOR=y
```

## boards/mimxrt1170_evk_mimxrt1176_cm7.overlay
```dts
/* SPDX-License-Identifier: Apache-2.0 */

/*
 * Renode does not model the RT1170 CAAM entropy block. This proof image uses
 * Zephyr's deterministic test RNG so PSA verification can run in simulation.
 * The product configuration must keep the hardware entropy source enabled.
 */
&caam {
    status = "disabled";
};
```

## src/main.c
```c
/* SPDX-License-Identifier: Apache-2.0 */

#include <stdint.h>
#include <string.h>

#include <zephyr/kernel.h>
#include <zephyr/sys/printk.h>

#include "wasm_export.h"
#include "wasm_package.h"
#include "aesl_package.h"
#include "aesl_public_key.h"

#define WASM_STACK_SIZE 8192U
#define WASM_HEAP_SIZE  8192U
#define HOST_LABEL_ID   1
#define HOST_VALUE_MAX  9999

static char wamr_heap[CONFIG_WAMR_GLOBAL_HEAP_SIZE];

/*
 * Deliberately narrow product capability: a module may request one bounded
 * label value. It receives no filesystem, network, display-buffer, or raw
 * memory access. The production adapter can map this validated command onto
 * the e-ink scheduler rather than exporting that subsystem to WebAssembly.
 */
static int32_t host_label_set(wasm_exec_env_t exec_env, int32_t label_id,
                              int32_t value)
{
    ARG_UNUSED(exec_env);

    if (label_id != HOST_LABEL_ID || value < 0 || value > HOST_VALUE_MAX) {
        printk("WAMR HOST DENY: label=%d value=%d\n", label_id, value);
        return -1;
    }

    printk("WAMR HOST ALLOW: label=%d value=%d\n", label_id, value);
    return 0;
}

static NativeSymbol host_api[] = {
    { "aesl_label_set", host_label_set, "(ii)i", NULL },
};

static int verify_rejection_paths(void)
{
    struct aesl_wasm_package_view view;
    uint8_t tampered[sizeof(aesl_wasm_package)];
    uint8_t untrusted_key[sizeof(aesl_wasm_public_key)];

    memcpy(tampered, aesl_wasm_package, sizeof(tampered));
    tampered[AESL_WASM_PACKAGE_HEADER_SIZE] ^= 0x01;
    if (aesl_wasm_package_verify(tampered, sizeof(tampered),
                                 aesl_wasm_public_key,
                                 sizeof(aesl_wasm_public_key), &view) == 0) {
        printk("WAMR FAIL: tampered package accepted\n");
        return -1;
    }
    printk("PASS: rejected tampered WASM package\n");

    memcpy(untrusted_key, aesl_wasm_public_key, sizeof(untrusted_key));
    untrusted_key[sizeof(untrusted_key) - 1] ^= 0x01;
    if (aesl_wasm_package_verify(aesl_wasm_package,
                                 sizeof(aesl_wasm_package), untrusted_key,
                                 sizeof(untrusted_key), &view) == 0) {
        printk("WAMR FAIL: untrusted signer accepted\n");
        return -1;
    }
    printk("PASS: rejected untrusted WASM signer\n");
    return 0;
}

static int run_payload(void)
{
    struct aesl_wasm_package_view package;
    RuntimeInitArgs init_args;
    wasm_module_t module = NULL;
    wasm_module_inst_t instance = NULL;
    wasm_exec_env_t exec_env = NULL;
    wasm_function_inst_t entry;
    uint32_t argv[1] = { 0 };
    char error[128] = { 0 };
    int rc = -1;

    memset(&init_args, 0, sizeof(init_args));
    init_args.mem_alloc_type = Alloc_With_Pool;
    init_args.mem_alloc_option.pool.heap_buf = wamr_heap;
    init_args.mem_alloc_option.pool.heap_size = sizeof(wamr_heap);
    init_args.native_module_name = "env";
    init_args.native_symbols = host_api;
    init_args.n_native_symbols = ARRAY_SIZE(host_api);

    if (!wasm_runtime_full_init(&init_args)) {
        printk("WAMR FAIL: runtime init\n");
        return -1;
    }

    rc = aesl_wasm_package_verify(aesl_wasm_package,
                                  sizeof(aesl_wasm_package),
                                  aesl_wasm_public_key,
                                  sizeof(aesl_wasm_public_key), &package);
    if (rc != 0) {
        printk("WAMR FAIL: package verification=%d\n", rc);
        goto out;
    }
    printk("WAMR PACKAGE VERIFIED: version=%u bytes=%u\n",
           package.version, (unsigned int)package.payload_size);

    module = wasm_runtime_load((uint8_t *)package.payload,
                               package.payload_size, error,
                               sizeof(error));
    if (module == NULL) {
        printk("WAMR FAIL: load: %s\n", error);
        goto out;
    }

    instance = wasm_runtime_instantiate(module, WASM_STACK_SIZE,
                                        WASM_HEAP_SIZE, error, sizeof(error));
    if (instance == NULL) {
        printk("WAMR FAIL: instantiate: %s\n", error);
        goto out;
    }

    entry = wasm_runtime_lookup_function(instance, "app_main");
    if (entry == NULL) {
        printk("WAMR FAIL: app_main missing\n");
        goto out;
    }

    exec_env = wasm_runtime_create_exec_env(instance, WASM_STACK_SIZE);
    if (exec_env == NULL) {
        printk("WAMR FAIL: exec env\n");
        goto out;
    }

    if (!wasm_runtime_call_wasm(exec_env, entry, 0, argv)) {
        printk("WAMR FAIL: exception: %s\n",
               wasm_runtime_get_exception(instance));
        goto out;
    }

    rc = (int32_t)argv[0];

out:
    if (exec_env != NULL) {
        wasm_runtime_destroy_exec_env(exec_env);
    }
    if (instance != NULL) {
        wasm_runtime_deinstantiate(instance);
    }
    if (module != NULL) {
        wasm_runtime_unload(module);
    }
    wasm_runtime_destroy();
    return rc;
}

int main(void)
{
    int64_t started = k_uptime_get();
    int rc;

    printk("WAMR RT1170: starting isolated module\n");
    if (verify_rejection_paths() != 0) {
        return -1;
    }
    rc = run_payload();
    if (rc == 0) {
        printk("PASS: WAMR capability host API\n");
    } else {
        printk("FAIL: WAMR module result=%d\n", rc);
    }
    printk("WAMR elapsed_ms=%lld\n", k_uptime_delta(&started));
    return rc;
}
```

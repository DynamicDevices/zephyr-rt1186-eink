## mender-mcu-integration/west.yml
```yaml
manifest:

  remotes:
    - name: zephyrproject-rtos
      url-base: https://github.com/zephyrproject-rtos
    - name: mender
      url-base: https://github.com/mendersoftware
    - name: dynamicdevices
      url-base: https://github.com/DynamicDevices

  projects:
    - name: zephyr
      remote: zephyrproject-rtos
      revision: v4.4.0
      import:
        name-allowlist:
          - cmsis_6
          - mbedtls
          - tf-psa-crypto
          - mcuboot
          - hal_nxp
          - hal_nordic
          - hal_espressif
          - littlefs
    - name: mender-mcu
      remote: dynamicdevices
      # Full SHA required: CI/shallow west update cannot resolve abbreviated refs.
      # Shared pin policy: https://github.com/DynamicDevices/mender-mcu/blob/feature/zephyr-ram-stage-on-main/PIN-POLICY.md
      revision: c121219d704fc159f37c9da1fc946aba0379454a
      path: modules/mender-mcu
      import: true
    - name: improv-zephyr
      url: https://github.com/beriberikix/improv-zephyr
      revision: b65d2aaa39d48ec0fee11aa3eecd0609bbe30f3c
      path: modules/improv-zephyr

  self:
    path: mender-mcu-integration
```
